## meta-custom-conf/conf/layer.conf
```bitbake
# We have a conf and classes directory, add to BBPATH
BBPATH .= ":${LAYERDIR}"

# We have recipes-* directories, add to BBFILES
BBFILES += "${LAYERDIR}/recipes-*/*/*.bb \
            ${LAYERDIR}/recipes-*/*/*.bbappend"

BBFILE_COLLECTIONS += "meta-custom-conf"
BBFILE_PATTERN_meta-custom-conf = "^${LAYERDIR}/"
BBFILE_PRIORITY_meta-custom-conf = "11"

LAYERDEPENDS_meta-custom-conf = "core"
LAYERSERIES_COMPAT_meta-custom-conf = "scarthgap"
```
